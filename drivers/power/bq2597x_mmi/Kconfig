## drivers/power/bq2597x_mmi/Kconfig
```kconfig
config BQ2597X_MMI_CHARGING
	tristate "BQ2597X Battery Charging Driver MMI Revision"
	help
	  Say Y here to enable bq2597x battery charging driver

	  To compile this driver as a module, choose M here. The module
	  will be called bq2597x_mmi.
```

## drivers/sensors/Kconfig
```kconfig
config SENSORS_SSC
	bool "Enable Sensors Driver Support for SSC"
	help
	  Add support for sensors SSC driver.
	  This driver is used for exercising sensors use case,
	  time syncing with ADSP clock.

config SENSORS
	tristate "Sensors Class Support"
	help
	  This option enables the sensor sysfs class in /sys/class/sensors.
	  You'll need this to do anything useful with sensorss. If unsure, say N.

	  To compile this driver as a module, choose M here. This module 
	  will be called sensors_class.
```
